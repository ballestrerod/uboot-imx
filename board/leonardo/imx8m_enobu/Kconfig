## board/leonardo/imx8m_enobu/Kconfig
```kconfig
if TARGET_IMX8M_ENOBU

config SYS_BOARD
	default "imx8m_enobu"

config SYS_VENDOR
	default "leonardo"

config SYS_CONFIG_NAME
	default "imx8m_enobu"

source "board/freescale/common/Kconfig"

endif
```

## board/leonardo/imx8mq_enobu/Kconfig
```kconfig
if TARGET_IMX8MQ_ENOBU

config SYS_BOARD
	default "imx8mq_enobu"

config SYS_VENDOR
	default "leonardo"

config SYS_CONFIG_NAME
	default "imx8mq_enobu"

source "board/freescale/common/Kconfig"

endif
```
